/**
 * Standalone Lightweight SSD1306 OLED Driver for ESP8266 / NodeMCU
 * Zero External Dependencies (Only uses built-in Wire.h)
 */

#ifndef __SSD1306_DRIVER_H__
#define __SSD1306_DRIVER_H__

#include <Wire.h>
#include <Arduino.h>

#define SSD1306_I2C_ADDR 0x3C
#define SSD1306_WIDTH    128
#define SSD1306_HEIGHT   64

// Minimal 5x7 ASCII Font Bitmap Table (Digits 0-9, A-Z, Space, P, Q, R, U, N, etc.)
static const uint8_t PROGMEM font5x7[][5] = {
  {0x00, 0x00, 0x00, 0x00, 0x00}, // ' ' (32)
  {0x00, 0x00, 0x5F, 0x00, 0x00}, // '!'
  {0x00, 0x07, 0x00, 0x07, 0x00}, // '"'
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  {0x61, 0x51, 0x49, 0x45, 0x43}  // 'Z'
};

class SSD1306Driver {
private:
  uint8_t buffer[SSD1306_WIDTH * SSD1306_HEIGHT / 8];

  void sendCommand(uint8_t cmd) {
    Wire.beginTransmission(SSD1306_I2C_ADDR);
    Wire.write(0x00);
    Wire.write(cmd);
    Wire.endTransmission();
  }

public:
  SSD1306Driver() {}

  bool begin(int sdaPin = D2, int sclPin = D1) {
    Wire.begin(sdaPin, sclPin);
    Wire.setClock(400000);

    sendCommand(0xAE); // Display OFF
    sendCommand(0xD5); sendCommand(0x80); // Set Clock Ratio
    sendCommand(0xA8); sendCommand(0x3F); // Set Multiplex
    sendCommand(0xD3); sendCommand(0x00); // Display Offset
    sendCommand(0x40); // Start Line
    sendCommand(0x8D); sendCommand(0x14); // Enable Charge Pump
    sendCommand(0x20); sendCommand(0x00); // Horizontal Addressing
    sendCommand(0xA1); // Segment Remap
    sendCommand(0xC8); // COM Scan Decrement
    sendCommand(0xDA); sendCommand(0x12); // COM Pins
    sendCommand(0x81); sendCommand(0xCF); // Contrast
    sendCommand(0xD9); sendCommand(0xF1); // Pre-charge
    sendCommand(0xDB); sendCommand(0x40); // VCOM Detect
    sendCommand(0xA4); // Entire Display ON (Resume)
    sendCommand(0xA6); // Normal Display
    sendCommand(0xAF); // Display ON

    clear();
    display();
    return true;
  }

  void clear() {
    memset(buffer, 0, sizeof(buffer));
  }

  void setContrast(uint8_t val) {
    sendCommand(0x81);
    sendCommand(val);
  }

  void drawPixel(int x, int y, bool color = true) {
    if (x < 0 || x >= SSD1306_WIDTH || y < 0 || y >= SSD1306_HEIGHT) return;
    uint16_t idx = x + (y / 8) * SSD1306_WIDTH;
    if (color) {
      buffer[idx] |= (1 << (y % 8));
    } else {
      buffer[idx] &= ~(1 << (y % 8));
    }
  }

  void fillRect(int x, int y, int w, int h, bool color = true) {
    for (int i = x; i < x + w; i++) {
      for (int j = y; j < y + h; j++) {
        drawPixel(i, j, color);
      }
    }
  }

  void drawFastHLine(int x, int y, int w, bool color = true) {
    for (int i = x; i < x + w; i++) {
      drawPixel(i, y, color);
    }
  }

  void drawChar(int x, int y, char c, int size = 1) {
    if (c < 32 || c > 90) c = ' ';
    uint8_t idx = c - 32;

    for (int i = 0; i < 5; i++) {
      uint8_t line = pgm_read_byte(&font5x7[idx][i]);
      for (int j = 0; j < 8; j++) {
        if (line & (1 << j)) {
          if (size == 1) {
            drawPixel(x + i, y + j, true);
          } else {
            fillRect(x + (i * size), y + (j * size), size, size, true);
          }
        }
      }
    }
  }

  void printText(int x, int y, const char *text, int size = 1) {
    int curX = x;
    while (*text) {
      drawChar(curX, y, *text, size);
      curX += (6 * size);
      text++;
    }
  }

  void display() {
    sendCommand(0x21); sendCommand(0); sendCommand(127); // Column addr
    sendCommand(0x22); sendCommand(0); sendCommand(7);   // Page addr

    for (uint16_t i = 0; i < sizeof(buffer); i += 16) {
      Wire.beginTransmission(SSD1306_I2C_ADDR);
      Wire.write(0x40);
      for (uint8_t j = 0; j < 16; j++) {
        Wire.write(buffer[i + j]);
      }
      Wire.endTransmission();
    }
  }
};

#endif
